## Kconfig
```kconfig
# SPDX-License-Identifier: Apache-2.0

# Subsystem configuration options


source "Kconfig.zephyr"




rsource "app/Kconfig"  
	 
```

## app/Kconfig
```kconfig
# SPDX-License-Identifier: Apache-2.0

	
menu "app"

rsource "core/Kconfig"
rsource "external_interfaces/Kconfig"
rsource "hw_modules/Kconfig"
rsource "sw_modules/Kconfig"

endmenu
```

## app/hw_modules/Kconfig
```kconfig
# SPDX-License-Identifier: Apache-2.0

	
menu "hw_modules"

# rsource "detachable/Kconfig"
# rsource "main_processor/Kconfig"
# rsource "onboard/Kconfig"

rsource "qorvo_uwb_dwm3000/Kconfig"
 

endmenu
```

## app/hw_modules/qorvo_uwb_dwm3000/Kconfig
```kconfig
# SPDX-License-Identifier: Apache-2.0

	
menu "qorvo_uwb_dwm3000"

# todo: if configurations inside the dwm3000 module is later configured as Kconfig congiration, this file should be used.
 

menuconfig QORVO_UWB_DWM3000
	bool "Enable Qorvo UWB (Ultra-wide band) functionality for DWM3000"
	default n
	select SPI
	help
	  Enables or disables Qorvo UWB (Ultra-wide band) functionality for DWM3000.


if QORVO_UWB_DWM3000

# config SPI
# 	default y

endif # QORVO_UWB_DWM3000








endmenu
```

## sample.yaml
```yaml
sample:
  description: Qorvo uwb (ultra-wide band) DWM3000 application starting template to use with Zephyr applications.
    application
  name: qorvo uwb (ultra-wide band) DWM3000 application starting template
common:
    tags: introduction
```
